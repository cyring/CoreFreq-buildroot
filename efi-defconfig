## efi-defconfig
```kconfig
BR2_x86_64=y
BR2_TOOLCHAIN_BUILDROOT_GLIBC=y
BR2_GCC_VERSION_11_X=y
BR2_TARGET_GENERIC_HOSTNAME="CoreFreq"
BR2_TARGET_GENERIC_ISSUE="Welcome to CoreFreq"
BR2_ROOTFS_POST_BUILD_SCRIPT="./board/pc/post-build.sh"
BR2_ROOTFS_POST_IMAGE_SCRIPT="./board/pc/post-image-efi.sh"
BR2_LINUX_KERNEL=y
BR2_LINUX_KERNEL_USE_ARCH_DEFAULT_CONFIG=y
BR2_PACKAGE_GNU_EFI=y
BR2_PACKAGE_READLINE=y
BR2_PACKAGE_UTIL_LINUX=y
BR2_PACKAGE_UTIL_LINUX_LIBBLKID=y
BR2_PACKAGE_UTIL_LINUX_LIBUUID=y
BR2_TARGET_ROOTFS_EXT2=y
BR2_TARGET_ROOTFS_EXT2_SIZE="13M"
# BR2_TARGET_ROOTFS_TAR is not set
BR2_TARGET_GRUB2=y
BR2_TARGET_GRUB2_X86_64_EFI=y
BR2_PACKAGE_HOST_DOSFSTOOLS=y
BR2_PACKAGE_HOST_GENIMAGE=y
BR2_PACKAGE_HOST_MTOOLS=y
BR2_PACKAGE_COREFREQ=y
```

## external/package/corefreq/Config.in
```kconfig
config BR2_PACKAGE_COREFREQ
	bool "CoreFreq"
	help
	  CoreFreq: x86_64 monitoring software

	  https://github.com/cyring/CoreFreq
```

## mbr-defconfig
```kconfig
BR2_x86_64=y
BR2_TOOLCHAIN_BUILDROOT_GLIBC=y
BR2_GCC_VERSION_11_X=y
BR2_TARGET_GENERIC_HOSTNAME="CoreFreq"
BR2_TARGET_GENERIC_ISSUE="Welcome to CoreFreq"
BR2_LINUX_KERNEL=y
BR2_LINUX_KERNEL_USE_ARCH_DEFAULT_CONFIG=y
BR2_PACKAGE_GNU_EFI=y
BR2_TARGET_ROOTFS_CPIO_BZIP2=y
BR2_TARGET_ROOTFS_ISO9660=y
BR2_TARGET_ROOTFS_ISO9660_HYBRID=y
# BR2_TARGET_ROOTFS_TAR is not set
BR2_TARGET_SYSLINUX=y
BR2_PACKAGE_COREFREQ=y
```
